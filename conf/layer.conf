## conf/layer.conf
```bitbake
# We have a conf and classes directory, add to BBPATH
BBPATH .= ":${LAYERDIR}"

# We have recipes-* directories, add to BBFILES
BBFILES += "${LAYERDIR}/recipes-*/*/*.bb \
            ${LAYERDIR}/recipes-*/*/*.bbappend"

BBFILE_COLLECTIONS += "meta-stm32-layer"
BBFILE_PATTERN_meta-stm32-layer = "^${LAYERDIR}/"
BBFILE_PRIORITY_meta-stm32-layer = "6"

LAYERDEPENDS_meta-stm32-layer = "core"
LAYERSERIES_COMPAT_meta-stm32-layer = "thud warrior"
```

## conf/machine/discovery-stm32f072.conf
```bitbake
#@TYPE: Machine
#@NAME: ST discovery-stm32f072
#@DESCRIPTION: ST Discovery STM32F072 evaluation board

require conf/machine/include/stm32f0x.inc
```

## conf/machine/discovery-stm32f412.conf
```bitbake
#@TYPE: Machine
#@NAME: ST discovery-stm32f412
#@DESCRIPTION: ST Discovery STM32F412 evaluation board

require conf/machine/include/stm32f4x.inc
```

## conf/machine/include/stm32f0x.inc
```bitbake
#@TYPE: Machine
#@NAME: STM32F0x
#@DESCRIPTION: STM32F0x (Cortex-M0) machine

require conf/machine/include/arm/armv6m/tune-cortexm0.inc

TUNE_FEATURES = "armv6m cortexm0" 
```

## conf/machine/include/stm32f3x.inc
```bitbake
#@TYPE: Machine
#@NAME: STM32F3x
#@DESCRIPTION: STM32F3x (Cortex-M3) machine

require conf/machine/include/tune-cortexm3.inc

TUNE_FEATURES = "armv7m cortexm3" 
```

## conf/machine/include/stm32f4x.inc
```bitbake
#@TYPE: Machine
#@NAME: STM32F4x
#@DESCRIPTION: STM32F4x (Cortex-M4) machine

require conf/machine/include/arm/armv7m/tune-cortexm4.inc

TUNE_FEATURES = "armv7m cortexm4" 
```

## conf/machine/nucleo-f411re.conf
```bitbake
#@TYPE: Machine
#@NAME: ST nucleo-f411re
#@DESCRIPTION: ST Nucleo F411RE evaluation board

require conf/machine/include/stm32f4x.inc
```
